## boards/shields/lily58_portrait/Kconfig.defconfig
```kconfig
if SHIELD_LILY58_PORTRAIT

choice ZMK_DISPLAY_STATUS_SCREEN
    default ZMK_DISPLAY_STATUS_SCREEN_CUSTOM
endchoice

config ZMK_DISPLAY_STATUS_SCREEN_CUSTOM
    select LV_USE_IMG
    select LV_USE_CANVAS
    select LV_FONT_UNSCII_8

choice ZMK_DISPLAY_WORK_QUEUE
    default ZMK_DISPLAY_WORK_QUEUE_DEDICATED
endchoice

config LV_Z_MEM_POOL_SIZE
    default 8192

config LV_Z_BITS_PER_PIXEL
    default 1

choice LV_COLOR_DEPTH
    default LV_COLOR_DEPTH_1
endchoice

config LILY58_PORTRAIT_FLIP
    bool "Rotate the portrait screen by another 180 degrees"
    default n

endif
```

## boards/shields/lily58_portrait/Kconfig.shield
```kconfig
config SHIELD_LILY58_PORTRAIT
    def_bool $(shields_list_contains,lily58_portrait)
```
